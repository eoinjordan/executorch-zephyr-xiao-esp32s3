## CMakeLists.txt
```
# Copyright (c) 2026 Eoin Jordan
# SPDX-License-Identifier: Apache-2.0
#
# ExecuTorch on the Seeed XIAO ESP32S3 (Sense) under Zephyr.
#
# Two programs of the same network are embedded as const arrays and only the
# operators they use are linked (selective build):
#
#   model/mnist_tiny.pte           fp32, portable kernels
#   model/mnist_tiny_cmsis_nn.pte  int8, cortex_m operators on CMSIS-NN
#
# The ESP32-S3 is an Xtensa LX7, not an Arm core. CMSIS-NN has a plain C code
# path next to its DSP and Helium ones, and that path builds for any target,
# so the quantised kernels run here too. -DAPP_CMSIS_NN=OFF leaves them and
# the int8 program out.
#
# With CONFIG_APP_LEGO (lego.conf) the application is the brick detector
# instead, src/lego.cpp, and the two programs are those of BrickNet:
#
#   model/lego_bricknet.pte           fp32, portable kernels
#   model/lego_bricknet_cmsis_nn.pte  int8, cortex_m operators on CMSIS-NN

cmake_minimum_required(VERSION 3.24)

set(CMAKE_SKIP_INSTALL_RULES ON CACHE BOOL "" FORCE)

option(APP_CMSIS_NN "Also embed the int8 program and build the CMSIS-NN kernels" ON)

set(ET_PTE_FILE_PATH
    "${CMAKE_CURRENT_SOURCE_DIR}/model/mnist_tiny.pte"
    CACHE FILEPATH "Path to the fp32 ExecuTorch .pte model to embed"
)
set(ET_PTE_Q_FILE_PATH
    "${CMAKE_CURRENT_SOURCE_DIR}/model/mnist_tiny_cmsis_nn.pte"
    CACHE FILEPATH "Path to the int8 (cortex_m) ExecuTorch .pte model to embed"
)
set(LEGO_PTE_FILE_PATH
    "${CMAKE_CURRENT_SOURCE_DIR}/model/lego_bricknet.pte"
    CACHE FILEPATH "Path to the fp32 BrickNet .pte (CONFIG_APP_LEGO)"
)
set(LEGO_PTE_Q_FILE_PATH
    "${CMAKE_CURRENT_SOURCE_DIR}/model/lego_bricknet_cmsis_nn.pte"
    CACHE FILEPATH "Path to the int8 (cortex_m) BrickNet .pte (CONFIG_APP_LEGO)"
)
foreach(_var ET_PTE_FILE_PATH ET_PTE_Q_FILE_PATH LEGO_PTE_FILE_PATH LEGO_PTE_Q_FILE_PATH)
  if(NOT IS_ABSOLUTE "${${_var}}")
    get_filename_component(
      ${_var} "${${_var}}" ABSOLUTE BASE_DIR "${CMAKE_CURRENT_SOURCE_DIR}"
    )
  endif()
endforeach()
if(NOT EXISTS "${ET_PTE_FILE_PATH}")
  message(FATAL_ERROR "Model not found at ET_PTE_FILE_PATH=${ET_PTE_FILE_PATH}. "
                      "Run train/train_mnist.py first or pass -DET_PTE_FILE_PATH=<file>.")
endif()
if(APP_CMSIS_NN AND NOT EXISTS "${ET_PTE_Q_FILE_PATH}")
  message(FATAL_ERROR "Model not found at ET_PTE_Q_FILE_PATH=${ET_PTE_Q_FILE_PATH}. "
                      "Run train/export_cmsis_nn.py or pass -DAPP_CMSIS_NN=OFF.")
endif()

# The ExecuTorch Zephyr module builds its Cortex-M backend (the cortex_m
# kernels and CMSIS-NN) only when CONFIG_CPU_CORTEX_M is set. Nothing in that
# backend needs an Arm core, so ask for it here, before the module is read.
if(APP_CMSIS_NN)
  set(EXECUTORCH_BUILD_CORTEX_M ON CACHE BOOL "" FORCE)
endif()

find_package(Zephyr REQUIRED HINTS $ENV{ZEPHYR_BASE})
project(executorch_xiao_esp32s3)

find_package(Python3 COMPONENTS Interpreter REQUIRED)

# The application mode is a Kconfig choice, known only from here on.
if(CONFIG_APP_LEGO)
  set(ET_PTE_FILE_PATH "${LEGO_PTE_FILE_PATH}")
  set(ET_PTE_Q_FILE_PATH "${LEGO_PTE_Q_FILE_PATH}")
  set(_lego_models "${ET_PTE_FILE_PATH}")
  if(APP_CMSIS_NN)
    list(APPEND _lego_models "${ET_PTE_Q_FILE_PATH}")
  endif()
  foreach(_pte ${_lego_models})
    if(NOT EXISTS "${_pte}")
      message(FATAL_ERROR "Model not found at ${_pte}. Run train/train_lego.py and "
                          "train/export_lego.py.")
    endif()
  endforeach()
endif()

set(CMAKE_CXX_FLAGS
    "${CMAKE_CXX_FLAGS} -Wall -Wno-switch -Wno-float-conversion -ffunction-sections -fdata-sections"
)

if(NOT DEFINED EXECUTORCH_DIR)
  if(DEFINED ZEPHYR_EXECUTORCH_MODULE_DIR)
    set(EXECUTORCH_DIR ${ZEPHYR_EXECUTORCH_MODULE_DIR})
  else()
    message(FATAL_ERROR "ExecuTorch Zephyr module not found. Check west.yml and run west update.")
  endif()
endif()
message(STATUS "EXECUTORCH_DIR=${EXECUTORCH_DIR}")

include(${EXECUTORCH_DIR}/tools/cmake/Utils.cmake)
# arm_runner_create_selected_ops_lib() is a thin, target-agnostic wrapper over
# ExecuTorch's codegen helpers; it works unchanged for Xtensa.
include(${EXECUTORCH_DIR}/backends/arm/cmake/ArmRunnerUtils.cmake)

# Portable kernels target must exist even though the full portable ops
# library is disabled in prj.conf (CONFIG_EXECUTORCH_BUILD_PORTABLE_OPS=n).
# On ExecuTorch v1.5.1 the KERNELS_ONLY flag is not yet honoured, so the
# all-ops registration library is still compiled; it is never linked (check
# zephyr.map: only the op_*.cpp.obj for ops in the .pte appear).
if(NOT TARGET portable_kernels)
  set(EXECUTORCH_PORTABLE_BUILD_KERNELS_ONLY ON)
  add_subdirectory(
    ${EXECUTORCH_DIR}/kernels/portable
    ${CMAKE_CURRENT_BINARY_DIR}/executorch/kernels/portable
  )
  unset(EXECUTORCH_PORTABLE_BUILD_KERNELS_ONLY)
endif()

set(_app_cmsis_nn OFF)
if(APP_CMSIS_NN)
  if(TARGET cortex_m_kernels)
    set(_app_cmsis_nn ON)
  else()
    message(FATAL_ERROR "APP_CMSIS_NN is ON but the ExecuTorch module did not build "
                        "cortex_m_kernels. Start from a clean build directory (west build -p).")
  endif()
endif()

# One registration library per kernel library, each with only the operators
# the embedded programs use. An operator may be registered once, so the
# portable library takes the union over both programs: the int8 program is
# all cortex_m operators except for a layout copy that the portable kernels
# provide.
set(_app_models "${ET_PTE_FILE_PATH}")
if(_app_cmsis_nn)
  list(APPEND _app_models "${ET_PTE_Q_FILE_PATH}")
endif()
execute_process(
  COMMAND ${Python3_EXECUTABLE} ${CMAKE_CURRENT_SOURCE_DIR}/scripts/pte_ops.py
          --exclude cortex_m:: ${_app_models}
  OUTPUT_VARIABLE _app_portable_ops
  OUTPUT_STRIP_TRAILING_WHITESPACE
  RESULT_VARIABLE _app_pte_ops_result
)
if(NOT _app_pte_ops_result EQUAL 0 OR _app_portable_ops STREQUAL "")
  message(FATAL_ERROR "scripts/pte_ops.py could not list the operators of ${_app_models}. "
                      "It needs the executorch Python package (requirements.txt).")
endif()
message(STATUS "Portable operators: ${_app_portable_ops}")

set(_selected_ops_libs)
arm_runner_create_selected_ops_lib(
  LIB_NAME "xiao_portable_ops_lib"
  FUNCTIONS_YAML "${EXECUTORCH_DIR}/kernels/portable/functions.yaml"
  OP_LIST "${_app_portable_ops}"
  KERNEL_LIBS portable_kernels
  DEPS executorch
  DTYPE_SELECTIVE_BUILD ""
)
list(APPEND _selected_ops_libs xiao_portable_ops_lib)

if(_app_cmsis_nn)
  arm_runner_create_selected_ops_lib(
    LIB_NAME "xiao_cortex_m_ops_lib"
    CUSTOM_OPS_YAML "${EXECUTORCH_DIR}/backends/cortex_m/ops/operators.yaml"
    OPS_FROM_MODEL "${ET_PTE_Q_FILE_PATH}"
    KERNEL_LIBS cortex_m_kernels
    DEPS executorch
  )
  list(APPEND _selected_ops_libs xiao_cortex_m_ops_lib)
endif()

# flatcc builds a host tool as part of the ExecuTorch tree; give it a writable
# copy inside the build directory (same workaround as the upstream sample).
set(_local_flatcc_root ${CMAKE_BINARY_DIR}/flatcc_src)
if(NOT EXISTS ${_local_flatcc_root}/CMakeLists.txt)
  file(MAKE_DIRECTORY ${_local_flatcc_root})
  execute_process(
    COMMAND ${CMAKE_COMMAND} -E copy_directory
            ${EXECUTORCH_DIR}/third-party/flatcc ${_local_flatcc_root}
  )
endif()
set(EXECUTORCH_FLATCC_SOURCE_ROOT ${_local_flatcc_root} CACHE PATH "" FORCE)
set(EXECUTORCH_FLATCC_INSTALL_ROOT ${_local_flatcc_root} CACHE PATH "" FORCE)

# Embed the models.
function(app_embed_pte pte header symbol)
  add_custom_command(
    OUTPUT ${header}
    COMMAND ${Python3_EXECUTABLE} ${CMAKE_CURRENT_SOURCE_DIR}/scripts/pte_to_header.py
            --pte ${pte} --out ${header} --symbol ${symbol}
    DEPENDS ${pte} ${CMAKE_CURRENT_SOURCE_DIR}/scripts/pte_to_header.py
    COMMENT "Converting ${pte} to ${header}"
  )
endfunction()

set(_model_headers ${CMAKE_CURRENT_BINARY_DIR}/model_pte.h)
app_embed_pte(${ET_PTE_FILE_PATH} ${CMAKE_CURRENT_BINARY_DIR}/model_pte.h model_pte)
if(_app_cmsis_nn)
  list(APPEND _model_headers ${CMAKE_CURRENT_BINARY_DIR}/model_q_pte.h)
  app_embed_pte(${ET_PTE_Q_FILE_PATH} ${CMAKE_CURRENT_BINARY_DIR}/model_q_pte.h model_q_pte)
endif()
add_custom_target(gen_model_header DEPENDS ${_model_headers})
add_dependencies(app gen_model_header)

# The ExecuTorch module's runtime includes <zephyr/kernel.h>, which needs
# Zephyr's generated headers. Order it explicitly so a parallel build does not
# compile it before they exist.
if(TARGET zephyr_generated_headers)
  foreach(_t executorch_core executorch portable_kernels kernels_util_all_deps cortex_m_kernels)
    if(TARGET ${_t})
      add_dependencies(${_t} zephyr_generated_headers)
    endif()
  endforeach()
endif()

if(CONFIG_APP_LEGO)
  target_sources(app PRIVATE src/lego.cpp)
else()
  target_sources(app PRIVATE src/main.cpp)
endif()
target_sources_ifdef(CONFIG_APP_CAMERA app PRIVATE src/camera.c)
target_sources_ifdef(CONFIG_APP_SCREEN app PRIVATE src/screen.c)

target_compile_definitions(
  app PRIVATE
  APP_METHOD_ALLOCATOR_POOL_SIZE=${CONFIG_EXECUTORCH_METHOD_ALLOCATOR_POOL_SIZE}
  APP_TEMP_ALLOCATOR_POOL_SIZE=${CONFIG_EXECUTORCH_TEMP_ALLOCATOR_POOL_SIZE}
  APP_Q_METHOD_ALLOCATOR_POOL_SIZE=${CONFIG_APP_CMSIS_NN_METHOD_POOL_SIZE}
  APP_Q_TEMP_ALLOCATOR_POOL_SIZE=${CONFIG_APP_CMSIS_NN_TEMP_POOL_SIZE}
)
if(_app_cmsis_nn)
  target_compile_definitions(app PRIVATE APP_CMSIS_NN=1)
endif()

target_link_libraries(app PRIVATE libexecutorch ${_selected_ops_libs})
target_include_directories(app PRIVATE src ${CMAKE_CURRENT_BINARY_DIR})
```

## Kconfig
```
# Copyright (c) 2026 Eoin Jordan
# SPDX-License-Identifier: Apache-2.0

source "Kconfig.zephyr"

menu "ExecuTorch XIAO ESP32S3 sample"

config EXECUTORCH_METHOD_ALLOCATOR_POOL_SIZE
	int "Method allocator pool size of the fp32 program in bytes"
	default 98304
	depends on EXECUTORCH
	help
	  Static pool used for the Method instance, its metadata and the
	  memory-planned activation buffers. The fp32 TinyDigitNet uses about
	  60 KiB of it.

config EXECUTORCH_TEMP_ALLOCATOR_POOL_SIZE
	int "Temporary allocator pool size of the fp32 program in bytes"
	default 16384
	depends on EXECUTORCH
	help
	  Scratch pool for temporary allocations inside kernels. Reset after
	  every kernel call.

config APP_CMSIS_NN_METHOD_POOL_SIZE
	int "Method allocator pool size of the int8 program in bytes"
	default 32768
	help
	  As above, for the quantised program that runs on the CMSIS-NN
	  kernels. Its tensors are a quarter of the size of the fp32 ones.
	  Unused when the firmware is built with -DAPP_CMSIS_NN=OFF.

config APP_CMSIS_NN_TEMP_POOL_SIZE
	int "Temporary allocator pool size of the int8 program in bytes"
	default 16384
	help
	  Scratch pool of the quantised program. The CMSIS-NN convolution
	  takes its working buffer from here.

config APP_CAMERA
	bool "Classify live frames from the OV2640 camera"
	depends on VIDEO
	help
	  After the embedded self-test, grab RGB565 frames from the camera
	  (XIAO ESP32S3 Sense), centre-crop, downsample to 28x28, invert and
	  normalise, then run the model on each frame. Enable with
	  -DEXTRA_CONF_FILE=camera.conf on the Sense board target.

config APP_CAMERA_INTERVAL_MS
	int "Delay between camera inferences in milliseconds"
	default 1000
	depends on APP_CAMERA

config APP_CAMERA_SWAP_BYTES
	bool "Treat RGB565 frames as big-endian"
	depends on APP_CAMERA
	help
	  Enable if the ASCII preview printed by the firmware looks like noise.
	  The DVP interface may deliver RGB565 with the two bytes swapped.

config APP_CAMERA_ROTATE_180
	bool "Turn the camera picture half a turn"
	depends on APP_CAMERA
	help
	  Enable when the camera board is mounted upside down, for example
	  on the gripper-top holder with the cover fitted. The picture the
	  model sees, the screen and the DET coordinates are then all upright.

config APP_LEGO
	bool "Detect bricks by colour instead of reading digits"
	help
	  Build the brick detector (src/lego.cpp) in place of the MNIST
	  demo: BrickNet finds yellow, white and red bricks and a blue parts
	  bin in the camera picture and prints one DET line a frame for a
	  host that drives an arm. Enable with lego.conf, which also turns
	  on the PSRAM that the fp32 program needs.

if APP_LEGO

config APP_LEGO_METHOD_POOL_SIZE
	int "Method allocator pool size of the int8 BrickNet in bytes"
	default 81920
	help
	  Static pool in internal RAM for the quantised program. The firmware
	  prints how much of it is used.

config APP_LEGO_TEMP_POOL_SIZE
	int "Temporary allocator pool size of each BrickNet program in bytes"
	default 8192

config APP_LEGO_FP32_POOL_SIZE
	int "Method allocator pool size of the fp32 BrickNet in bytes"
	default 393216
	help
	  Taken from the PSRAM at start-up. A 96 x 96 x 3 picture in float is
	  110 KiB before the first layer has run.

config APP_LEGO_INT8_STEPS
	int "Largest difference of the int8 self-test in output steps"
	default 8
	help
	  The self-test of the quantised program passes when no logit is
	  further than this many quantisation steps from the logits of the
	  quantised graph in PyTorch and the same objects are found.

config APP_LEGO_LIVE_FP32
	bool "Run the fp32 program on camera frames"
	help
	  The camera loop uses the int8 program when the firmware has it.
	  Turn this on to use the fp32 one, which is slower.

endif # APP_LEGO

config APP_SCREEN
	bool "Show the frame and the result on a display"
	depends on DISPLAY
	help
	  Draw what the model sees, the digit and the time each program took
	  on the display chosen in devicetree (zephyr,display). Written for
	  the Seeed Studio Round Display for XIAO (GC9A01, 240 x 240): build
	  with --shield seeed_xiao_round_display and display.conf.

config APP_SCREEN_SWAP_BYTES
	bool "Send the high byte of each pixel first"
	default y
	depends on APP_SCREEN
	help
	  The GC9A01 driver passes the buffer to the panel as it is, and the
	  panel reads the high byte of an RGB565 pixel first. At start-up the
	  screen shows three squares that must be red, green and blue from
	  left to right; if they are not, turn this off.

config APP_SCREEN_BAND_ROWS
	int "Rows drawn and sent to the panel at a time"
	default 40
	range 8 240
	depends on APP_SCREEN
	help
	  The picture is drawn in horizontal bands so that no full frame
	  buffer is needed: 240 x 240 pixels would take 115 KiB, a band of 40
	  rows takes 19 KiB.

endmenu
```

## prj.conf
```kconfig
# Copyright (c) 2026 Eoin Jordan
# SPDX-License-Identifier: Apache-2.0

# ExecuTorch runtime (modules/lib/executorch, zephyr/Kconfig)
CONFIG_EXECUTORCH=y
# Only link the operators present in the .pte (selective build in CMakeLists)
CONFIG_EXECUTORCH_BUILD_PORTABLE_OPS=n
CONFIG_EXECUTORCH_ENABLE_LOGGING=y

# C++17 with full libstdc++ (ExecuTorch requires it)
CONFIG_CPP=y
CONFIG_STD_CPP17=y

# Stack and heap. The runtime uses our static pools for tensors, but Program
# parsing and std::vector in main() need some heap.
CONFIG_MAIN_STACK_SIZE=16384
CONFIG_HEAP_MEM_POOL_SIZE=32768

# Hardware float on the Xtensa LX7 FPU
CONFIG_FPU=y

# Print floats in logits
CONFIG_REQUIRES_FLOAT_PRINTF=y
CONFIG_PRINTK=y

# Pool sizes (see Kconfig). The firmware prints how much of each is used.
CONFIG_EXECUTORCH_METHOD_ALLOCATOR_POOL_SIZE=73728
CONFIG_EXECUTORCH_TEMP_ALLOCATOR_POOL_SIZE=8192
CONFIG_APP_CMSIS_NN_METHOD_POOL_SIZE=32768
CONFIG_APP_CMSIS_NN_TEMP_POOL_SIZE=16384

# Optimise for speed: this is an inference demo and the board has 8 MB of
# flash. It also keeps Windows builds working: with -Os GCC takes the
# size-optimised libstdc++ headers, whose path in the ESP32-S3 toolchain is
# longer than the 260 characters Windows allows by default.
CONFIG_SPEED_OPTIMIZATIONS=y
```

## camera.conf
```kconfig
# Copyright (c) 2026 Eoin Jordan
# SPDX-License-Identifier: Apache-2.0
#
# Extra config for the live-camera mode on xiao_esp32s3/esp32s3/procpu/sense:
#   west build -b xiao_esp32s3/esp32s3/procpu/sense firmware -- -DEXTRA_CONF_FILE=camera.conf

CONFIG_APP_CAMERA=y

CONFIG_VIDEO=y
CONFIG_LOG=y
CONFIG_LOG_MODE_DEFERRED=y
# printk goes straight to the console, so results are not dropped or
# reordered behind log lines.
CONFIG_LOG_PRINTK=n

# Two 160x120 RGB565 frames (38400 B each) in internal SRAM, no PSRAM needed.
CONFIG_VIDEO_BUFFER_POOL_NUM_MAX=2
CONFIG_VIDEO_BUFFER_POOL_HEAP_SIZE=81920
CONFIG_VIDEO_BUFFER_POOL_ALIGN=32
CONFIG_DMA_ESP32_MAX_DESCRIPTOR_NUM=64
```

## display.conf
```kconfig
# Copyright (c) 2026 Eoin Jordan
# SPDX-License-Identifier: Apache-2.0
#
# Extra config for the Seeed Studio Round Display for XIAO (GC9A01, 240 x 240):
#   west build -b xiao_esp32s3/esp32s3/procpu/sense --shield seeed_xiao_round_display firmware -- \
#     -DEXTRA_CONF_FILE="camera.conf;display.conf" -DEXTRA_DTC_OVERLAY_FILE=round_display.overlay

CONFIG_APP_SCREEN=y

CONFIG_DISPLAY=y

# With a screen to look at, classify as fast as the camera delivers.
CONFIG_APP_CAMERA_INTERVAL_MS=50
```

## lego.conf
```kconfig
# Copyright (c) 2026 Eoin Jordan
# SPDX-License-Identifier: Apache-2.0
#
# Extra config for the brick detector on xiao_esp32s3/esp32s3/procpu/sense
# with the round display:
#   west build -b xiao_esp32s3/esp32s3/procpu/sense --shield seeed_xiao_round_display firmware -- \
#     -DEXTRA_CONF_FILE="camera.conf;display.conf;lego.conf" \
#     -DEXTRA_DTC_OVERLAY_FILE=round_display.overlay

CONFIG_APP_LEGO=y

# The 8 MB of octal PSRAM in the ESP32-S3R8. The fp32 program works there;
# the int8 program, the camera and the screen stay in internal RAM.
CONFIG_ESP_SPIRAM=y
CONFIG_SPIRAM_MODE_OCT=y
CONFIG_ESP_SPIRAM_HEAP_SIZE=1048576

# The camera sends the high byte of each RGB565 pixel first. The digit demo
# gets away with reading it the other way round because it only wants ink
# against paper; colours need it right.
CONFIG_APP_CAMERA_SWAP_BYTES=y

# On the Sketchbot gripper-top holder with its cover the camera board sits
# upside down. Turn the picture so the screen and DET coordinates are upright.
# Set to n for a camera mounted the right way up.
CONFIG_APP_CAMERA_ROTATE_180=y

# The console takes the one-character requests of tools/lego_capture.py.
CONFIG_SERIAL=y
```

## round_display.overlay
```dts
/*
 * Copyright (c) 2026 Eoin Jordan
 * SPDX-License-Identifier: Apache-2.0
 *
 * Addition to the seeed_xiao_round_display shield for this application.
 */

#include <freq.h>

/* The shield asks for 100 MHz. The panel sits on header pins; 40 MHz sends a
 * full frame in 23 ms and leaves margin.
 */
&gc9a01_xiao_round_display {
	mipi-max-frequency = <DT_FREQ_M(40)>;
};
```

## src/main.cpp
```c
/* Copyright (c) 2026 Eoin Jordan
 * SPDX-License-Identifier: Apache-2.0
 *
 * ExecuTorch on the Seeed XIAO ESP32S3 (Sense) under Zephyr RTOS.
 *
 * 1. Load the programs embedded in flash (model_pte.h and, unless the
 *    firmware was built with -DAPP_CMSIS_NN=OFF, model_q_pte.h; both are
 *    generated at build time). They are the same network: one in fp32 on the
 *    portable kernels, one in int8 on the CMSIS-NN kernels.
 * 2. Run each once on an MNIST test image baked into test_input.h and
 *    compare the logits with the PyTorch reference, so a fresh board can
 *    prove the whole train -> export -> embed -> execute path works.
 * 3. With CONFIG_APP_CAMERA, keep classifying frames from the OV2640, and
 *    with CONFIG_APP_SCREEN show the frame, the digit and both times on the
 *    round display.
 */

#include <executorch/extension/data_loader/buffer_data_loader.h>
#include <executorch/runtime/core/memory_allocator.h>
#include <executorch/runtime/core/span.h>
#include <executorch/runtime/executor/memory_manager.h>
#include <executorch/runtime/executor/method.h>
#include <executorch/runtime/executor/program.h>
#include <executorch/runtime/platform/log.h>
#include <executorch/runtime/platform/runtime.h>

#include <zephyr/kernel.h>
#include <zephyr/sys/printk.h>
#include <zephyr/version.h>

#include <cmath>
#include <cstdint>
#include <cstring>
#include <vector>

#include "model_pte.h"  /* generated: model_pte[], model_pte_len */
#include "test_input.h" /* generated: kTestInput[], kTestExpectedLogits[] */

#ifdef APP_CMSIS_NN
#include "model_q_pte.h"  /* generated: model_q_pte[], model_q_pte_len */
#include "test_input_q.h" /* generated: kTestExpectedLogitsQ[], TEST_LOGIT_STEP_Q */
#endif

#ifdef CONFIG_APP_CAMERA
#include "camera.h"
#endif
#ifdef CONFIG_APP_SCREEN
#include "screen.h"
#endif

using executorch::aten::Tensor;
using executorch::aten::TensorImpl;
using executorch::extension::BufferDataLoader;
using executorch::runtime::Error;
using executorch::runtime::EValue;
using executorch::runtime::HierarchicalAllocator;
using executorch::runtime::MemoryAllocator;
using executorch::runtime::MemoryManager;
using executorch::runtime::Method;
using executorch::runtime::MethodMeta;
using executorch::runtime::Program;
using executorch::runtime::Result;
using executorch::runtime::Span;
using executorch::runtime::TensorInfo;

/* Same constants as train/model.py */
static constexpr float kMean = 0.1307f;
static constexpr float kStd = 0.3081f;
static constexpr size_t kNumClasses = 10;
static constexpr int kSide = 28;

/* Static pools: everything the runtime needs lives here, nothing in flash
 * is copied (a .pte is read in place from memory-mapped flash). Each program
 * has its own pair. */
alignas(16) static uint8_t method_pool[APP_METHOD_ALLOCATOR_POOL_SIZE];
alignas(16) static uint8_t temp_pool[APP_TEMP_ALLOCATOR_POOL_SIZE];
#ifdef APP_CMSIS_NN
alignas(16) static uint8_t q_method_pool[APP_Q_METHOD_ALLOCATOR_POOL_SIZE];
alignas(16) static uint8_t q_temp_pool[APP_Q_TEMP_ALLOCATOR_POOL_SIZE];
#endif

namespace {

/* One loaded program with its memory, ready to run. */
class Runner {
      public:
	Runner(const char *name, const uint8_t *pte, size_t pte_len, uint8_t *method_mem,
	       size_t method_size, uint8_t *temp_mem, size_t temp_size)
		: name(name), pte_len(pte_len), loader_(pte, pte_len),
		  method_allocator_(method_size, method_mem), temp_allocator_(temp_size, temp_mem)
	{
	}

	Error init();
	/* 784 normalised pixels in, 10 logits and the time of execute() out. */
	Error run(const float *pixels, float *logits, uint32_t *us);

	const char *const name;
	const size_t pte_len;

      private:
	BufferDataLoader loader_;
	MemoryAllocator method_allocator_;
	MemoryAllocator temp_allocator_;
	std::vector<Span<uint8_t>> planned_spans_;
	Program *program_ = nullptr;
	Method *method_ = nullptr;
	Tensor *input_tensor_ = nullptr;
	float *input_ = nullptr;
	size_t input_numel_ = 0;
};

Error Runner::init()
{
	Result<Program> program_res = Program::load(&loader_);
	if (!program_res.ok()) {
		ET_LOG(Error, "%s: Program::load failed: 0x%x", name, (unsigned)program_res.error());
		return program_res.error();
	}
	program_ = new Program(std::move(program_res.get()));

	const char *method_name = program_->get_method_name(0).get();
	Result<MethodMeta> meta = program_->method_meta(method_name);
	if (!meta.ok()) {
		return meta.error();
	}

	size_t planned = 0;
	for (size_t id = 0; id < meta->num_memory_planned_buffers(); ++id) {
		size_t size = static_cast<size_t>(meta->memory_planned_buffer_size(id).get());
		uint8_t *buf = static_cast<uint8_t *>(method_allocator_.allocate(size, 16));
		if (buf == nullptr) {
			ET_LOG(Error, "%s: planned buffer %zu (%zu B) does not fit the method pool",
			       name, id, size);
			return Error::MemoryAllocationFailed;
		}
		planned += size;
		planned_spans_.push_back({buf, size});
	}

	auto *planned_memory =
		new HierarchicalAllocator({planned_spans_.data(), planned_spans_.size()});
	auto *memory_manager =
		new MemoryManager(&method_allocator_, planned_memory, &temp_allocator_);

	Result<Method> method_res = program_->load_method(method_name, memory_manager);
	if (!method_res.ok()) {
		ET_LOG(Error, "%s: load_method(%s) failed: 0x%x", name, method_name,
		       (unsigned)method_res.error());
		return method_res.error();
	}
	method_ = new Method(std::move(method_res.get()));

	/* One input tensor, allocated once and reused for every inference. Both
	 * programs take float pixels: the int8 one starts with a quantize
	 * operator. Its input is in NHWC order, which for one channel is the
	 * same bytes as NCHW. */
	Result<TensorInfo> in_meta = meta->input_tensor_meta(0);
	if (!in_meta.ok()) {
		return in_meta.error();
	}
	input_numel_ = in_meta->nbytes() / sizeof(float);
	input_ = static_cast<float *>(method_allocator_.allocate(in_meta->nbytes(), 16));
	if (input_ == nullptr || input_numel_ != kSide * kSide) {
		return Error::MemoryAllocationFailed;
	}
	auto *impl = new TensorImpl(
		in_meta->scalar_type(), in_meta->sizes().size(),
		const_cast<TensorImpl::SizesType *>(in_meta->sizes().data()), input_,
		const_cast<TensorImpl::DimOrderType *>(in_meta->dim_order().data()));
	input_tensor_ = new Tensor(impl);

	printk("%-9s %6u bytes in flash, %6u planned, pool %6u of %6u bytes used\n", name,
	       (unsigned)pte_len, (unsigned)planned, (unsigned)method_allocator_.used_size(),
	       (unsigned)method_allocator_.size());
	return Error::Ok;
}

Error Runner::run(const float *pixels, float *logits, uint32_t *us)
{
	std::memcpy(input_, pixels, input_numel_ * sizeof(float));
	Error err = method_->set_input(EValue(*input_tensor_), 0);
	if (err != Error::Ok) {
		ET_LOG(Error, "%s: set_input failed: 0x%x", name, (unsigned)err);
		return err;
	}

	uint32_t t0 = k_cycle_get_32();
	err = method_->execute();
	uint32_t t1 = k_cycle_get_32();
	if (err != Error::Ok) {
		ET_LOG(Error, "%s: execute failed: 0x%x", name, (unsigned)err);
		return err;
	}
	*us = k_cyc_to_us_floor32(t1 - t0);

	const EValue &out = method_->get_output(0);
	if (!out.isTensor()) {
		return Error::InvalidState;
	}
	const Tensor &t = out.toTensor();
	const float *data = t.const_data_ptr<float>();
	for (size_t i = 0; i < kNumClasses && i < static_cast<size_t>(t.numel()); ++i) {
		logits[i] = data[i];
	}
	return Error::Ok;
}

size_t argmax(const float *v, size_t n)
{
	size_t best = 0;
	for (size_t i = 1; i < n; ++i) {
		if (v[i] > v[best]) {
			best = i;
		}
	}
	return best;
}

void print_logits(const float *logits)
{
	for (size_t i = 0; i < kNumClasses; ++i) {
		printk("  logit[%zu] = %9.4f%s\n", i, static_cast<double>(logits[i]),
		       i == argmax(logits, kNumClasses) ? "  <-- argmax" : "");
	}
}

/* Run the embedded test image, compare with the reference and time it.
 * `tolerance` is the largest difference from the reference that passes.
 * Returns the average time of an inference in microseconds, 0 on failure. */
uint32_t self_test(Runner &runner, const float *expected, float tolerance, size_t *digit)
{
	float logits[kNumClasses];
	uint32_t us = 0;

	if (runner.run(kTestInput, logits, &us) != Error::Ok) {
		printk("%s: FAIL: inference\n", runner.name);
		return 0;
	}
	size_t pred = argmax(logits, kNumClasses);
	float max_diff = 0.f;
	for (size_t i = 0; i < kNumClasses; ++i) {
		max_diff = fmaxf(max_diff, fabsf(logits[i] - expected[i]));
	}

	printk("\n%s self-test: embedded MNIST image, label %d\n", runner.name, TEST_INPUT_LABEL);
	print_logits(logits);
	printk("  predicted %zu, expected %d, max |esp32 - pytorch| = %.2e (limit %.2e)\n", pred,
	       TEST_INPUT_LABEL, static_cast<double>(max_diff), static_cast<double>(tolerance));
	bool pass = pred == TEST_INPUT_LABEL && max_diff <= tolerance;
	printk("%s SELF-TEST %s\n", runner.name, pass ? "PASS" : "FAIL");

	/* Warm timing: run a few more times and report the average. */
	uint32_t total = 0;
	const int reps = 10;
	for (int i = 0; i < reps; ++i) {
		runner.run(kTestInput, logits, &us);
		total += us;
	}
	printk("%s inference: %u us average over %d runs\n", runner.name, total / reps, reps);
	*digit = pred;
	return pass ? total / reps : 0;
}

#if defined(CONFIG_APP_CAMERA) && !defined(CONFIG_APP_SCREEN)
void print_preview(const uint8_t *img)
{
	for (int y = 0; y < kSide; ++y) {
		char line[kSide + 1];
		for (int x = 0; x < kSide; ++x) {
			uint8_t v = img[y * kSide + x];
			line[x] = v > 160 ? '#' : (v > 90 ? '+' : '.');
		}
		line[kSide] = '\0';
		printk("  %s\n", line);
	}
}
#endif

#ifdef CONFIG_APP_SCREEN
/* What the screen shows. The layout keeps inside the circle of the panel. */
struct View {
	const uint8_t *image; /* 28 x 28, what the model was given */
	const char *caption;
	int digit;
	uint32_t us;   /* fp32 on the portable kernels */
	int digit_q;   /* -1 without the int8 program */
	uint32_t us_q; /* int8 on CMSIS-NN */
};

void draw_view(void *ctx)
{
	const View *v = static_cast<const View *>(ctx);
	const int shown = v->digit_q >= 0 ? v->digit_q : v->digit;
	char text[24];

	screen_text(60, 24, "ExecuTorch", 2, COLOR_WHITE);
	screen_text(120 - 3 * static_cast<int>(strlen(v->caption)), 46, v->caption, 1, COLOR_GREY);

	screen_gray(30, 62, v->image, kSide, kSide, 3);
	text[0] = static_cast<char>('0' + shown);
	text[1] = '\0';
	screen_text(142, 72, text, 8, COLOR_AMBER);

	if (v->digit_q >= 0) {
		snprintk(text, sizeof(text), "CMSIS %d %u.%02ums", v->digit_q, v->us_q / 1000,
			 (v->us_q % 1000) / 10);
		screen_text(36, 156, text, 2, COLOR_LIME);
	}
	snprintk(text, sizeof(text), "FP32  %d %u.%02ums", v->digit, v->us / 1000,
		 (v->us % 1000) / 10);
	screen_text(36, 176, text, 2, COLOR_WHITE);

	/* Red, green, blue from left to right: a check of the colour order. */
	screen_fill(92, 202, 14, 14, COLOR_RED);
	screen_fill(113, 202, 14, 14, COLOR_GREEN);
	screen_fill(134, 202, 14, 14, COLOR_BLUE);
}
#endif

} // namespace

int main(void)
{
	executorch::runtime::runtime_init();

	printk("\nExecuTorch on %s (Zephyr %s)\n", CONFIG_BOARD_TARGET, KERNEL_VERSION_STRING);

	static Runner fp32("portable", model_pte, model_pte_len, method_pool, sizeof(method_pool),
			   temp_pool, sizeof(temp_pool));
	if (fp32.init() != Error::Ok) {
		printk("FAIL: runtime init (portable)\n");
		return 1;
	}
#ifdef APP_CMSIS_NN
	static Runner int8("cmsis-nn", model_q_pte, model_q_pte_len, q_method_pool,
			   sizeof(q_method_pool), q_temp_pool, sizeof(q_temp_pool));
	if (int8.init() != Error::Ok) {
		printk("FAIL: runtime init (cmsis-nn)\n");
		return 1;
	}
#endif

	/* --- 1. Self-test on the embedded MNIST image --------------------- */
	size_t digit = 0;
	uint32_t us = self_test(fp32, kTestExpectedLogits, 1e-3f, &digit);
#ifdef APP_CMSIS_NN
	/* Integer kernels may round a logit one step away from the PyTorch
	 * reference; anything beyond two steps is a real difference. */
	size_t digit_q = 0;
	uint32_t us_q = self_test(int8, kTestExpectedLogitsQ, 2.5f * TEST_LOGIT_STEP_Q, &digit_q);
	if (us != 0 && us_q != 0) {
		printk("\nint8 on CMSIS-NN is %u.%02ux the speed of fp32 on the portable kernels, "
		       "in %u%% of the flash\n",
		       us / us_q, (us % us_q) * 100 / us_q,
		       (unsigned)(model_q_pte_len * 100 / model_pte_len));
	}
#endif

#ifdef CONFIG_APP_SCREEN
	static uint8_t shown[kSide * kSide];
	static View view;

	for (int i = 0; i < kSide * kSide; ++i) {
		float v = (kTestInput[i] * kStd + kMean) * 255.f;
		shown[i] = static_cast<uint8_t>(fminf(fmaxf(v, 0.f), 255.f));
	}
	view.image = shown;
	view.caption = "self-test image";
	view.digit = static_cast<int>(digit);
	view.us = us;
	view.digit_q = -1;
#ifdef APP_CMSIS_NN
	view.digit_q = static_cast<int>(digit_q);
	view.us_q = us_q;
#endif
	const bool have_screen = screen_init() == 0;
	if (have_screen) {
		screen_render(draw_view, &view);
	}
#endif

	/* --- 2. Optional live camera loop ---------------------------------- */
#ifdef CONFIG_APP_CAMERA
	if (app_camera_init() != 0) {
		printk("camera init failed; stopping after self-test\n");
		return 0;
	}
	static float frame[kSide * kSide];
	static uint8_t preview[kSide * kSide];
	float logits[kNumClasses];

	for (;;) {
		if (app_camera_capture(frame, preview, kMean, kStd) != 0 ||
		    fp32.run(frame, logits, &us) != Error::Ok) {
			k_msleep(CONFIG_APP_CAMERA_INTERVAL_MS);
			continue;
		}
		digit = argmax(logits, kNumClasses);
#ifdef APP_CMSIS_NN
		if (int8.run(frame, logits, &us_q) != Error::Ok) {
			continue;
		}
		digit_q = argmax(logits, kNumClasses);
#endif

#ifdef CONFIG_APP_SCREEN
		if (have_screen) {
			view.image = preview;
			view.caption = "camera";
			view.digit = static_cast<int>(digit);
			view.us = us;
#ifdef APP_CMSIS_NN
			view.digit_q = static_cast<int>(digit_q);
			view.us_q = us_q;
#endif
			screen_render(draw_view, &view);
		}
#else
		printk("\ncamera frame:\n");
		print_preview(preview);
#endif
#ifdef APP_CMSIS_NN
		printk("digit %zu (cmsis-nn, %u us), %zu (portable, %u us)\n", digit_q, us_q, digit, us);
#else
		printk("digit %zu (%u us)\n", digit, us);
#endif
		k_msleep(CONFIG_APP_CAMERA_INTERVAL_MS);
	}
#endif
	return 0;
}
```

## src/camera.c
```c
/* Copyright (c) 2026 Eoin Jordan
 * SPDX-License-Identifier: Apache-2.0
 *
 * OV2640 capture on the XIAO ESP32S3 Sense through Zephyr's video API
 * (LCD_CAM DVP receiver + ov2640 driver, both in the board devicetree).
 */

#include "camera.h"

#include <errno.h>
#include <string.h>
#include <zephyr/device.h>
#include <zephyr/drivers/video.h>
#include <zephyr/kernel.h>
#include <zephyr/logging/log.h>

LOG_MODULE_REGISTER(app_camera, CONFIG_LOG_DEFAULT_LEVEL);

#if !DT_HAS_CHOSEN(zephyr_camera)
#error "No zephyr,camera chosen in devicetree. Build for xiao_esp32s3/esp32s3/procpu/sense."
#endif

#define CAM_WIDTH  160
#define CAM_HEIGHT 120

static const struct device *const cam = DEVICE_DT_GET(DT_CHOSEN(zephyr_camera));
static struct video_format fmt = {.type = VIDEO_BUF_TYPE_OUTPUT};

static void grab_thread(void *a, void *b, void *c);
K_THREAD_STACK_DECLARE(grab_stack, 2048);
static struct k_thread grab_data;

int app_camera_init(void)
{
	struct video_caps caps = {.type = VIDEO_BUF_TYPE_OUTPUT};
	int ret;

	if (!device_is_ready(cam)) {
		LOG_ERR("%s not ready", cam->name);
		return -ENODEV;
	}

	ret = video_get_caps(cam, &caps);
	if (ret < 0) {
		LOG_ERR("video_get_caps: %d", ret);
		return ret;
	}

	ret = video_get_format(cam, &fmt);
	if (ret < 0) {
		LOG_ERR("video_get_format: %d", ret);
		return ret;
	}
	fmt.pixelformat = VIDEO_PIX_FMT_RGB565;
	fmt.width = CAM_WIDTH;
	fmt.height = CAM_HEIGHT;

	ret = video_set_compose_format(cam, &fmt);
	if (ret < 0) {
		LOG_ERR("video_set_compose_format: %d", ret);
		return ret;
	}
	/* Read back pitch/size as the driver computed them. */
	ret = video_get_format(cam, &fmt);
	if (ret < 0) {
		return ret;
	}
	LOG_INF("camera %s: %s %ux%u pitch=%u size=%u", cam->name,
		VIDEO_FOURCC_TO_STR(fmt.pixelformat), fmt.width, fmt.height, fmt.pitch,
		fmt.size);

	if (caps.min_vbuf_count > CONFIG_VIDEO_BUFFER_POOL_NUM_MAX) {
		LOG_ERR("driver needs %u buffers, pool has %u", caps.min_vbuf_count,
			CONFIG_VIDEO_BUFFER_POOL_NUM_MAX);
		return -EINVAL;
	}

	for (int i = 0; i < CONFIG_VIDEO_BUFFER_POOL_NUM_MAX; i++) {
		struct video_buffer *vbuf = video_buffer_aligned_alloc(
			fmt.size, CONFIG_VIDEO_BUFFER_POOL_ALIGN, K_NO_WAIT);

		if (vbuf == NULL) {
			LOG_ERR("video buffer alloc failed (raise CONFIG_VIDEO_BUFFER_POOL_HEAP_SIZE)");
			return -ENOMEM;
		}
		vbuf->type = VIDEO_BUF_TYPE_OUTPUT;
		ret = video_enqueue(cam, vbuf);
		if (ret < 0) {
			LOG_ERR("video_enqueue: %d", ret);
			return ret;
		}
	}

	ret = video_stream_start(cam, VIDEO_BUF_TYPE_OUTPUT);
	if (ret < 0) {
		LOG_ERR("video_stream_start: %d", ret);
		return ret;
	}
	LOG_INF("camera streaming");
	k_thread_create(&grab_data, grab_stack, K_THREAD_STACK_SIZEOF(grab_stack), grab_thread, NULL, NULL, NULL,
			K_PRIO_COOP(2), 0, K_NO_WAIT); /* above main: it must run during an inference */
	k_thread_name_set(&grab_data, "camera");
	return 0;
}

/* RGB565 pixel at p as a host-order value. */
static inline uint16_t rgb565_at(const uint8_t *p)
{
	if (IS_ENABLED(CONFIG_APP_CAMERA_SWAP_BYTES)) {
		return (uint16_t)((p[0] << 8) | p[1]);
	}
	return (uint16_t)(p[0] | (p[1] << 8));
}

/* Where output pixel (ox, oy) of a side x side picture is stored: turned half
 * a turn when the camera board is mounted upside down.
 */
static inline uint32_t out_index(uint32_t ox, uint32_t oy, uint32_t side)
{
	if (IS_ENABLED(CONFIG_APP_CAMERA_ROTATE_180)) {
		return (side - 1 - oy) * side + (side - 1 - ox);
	}
	return oy * side + ox;
}

static inline uint8_t rgb565_to_gray(const uint8_t *p)
{
	uint16_t v = rgb565_at(p);
	uint32_t r = ((v >> 11) & 0x1f) << 3;
	uint32_t g = ((v >> 5) & 0x3f) << 2;
	uint32_t b = (v & 0x1f) << 3;

	/* ITU-R BT.601 luma, integer weights summing to 256 */
	return (uint8_t)((77 * r + 150 * g + 29 * b) >> 8);
}

#ifdef CONFIG_APP_LEGO
/* The newest frame as the brick detector wants it: the centre square in
 * colour, box-reduced to 96 x 96. Kept fresh by the thread for the reason
 * given below.
 */
static uint16_t latest_rgb[APP_RGB_SIDE * APP_RGB_SIDE];

static void reduce_rgb(const uint8_t *frame, uint16_t *out)
{
	const uint32_t w = fmt.width;
	const uint32_t h = fmt.height;
	const uint32_t side = (w < h) ? w : h;
	const uint32_t x0 = (w - side) / 2;
	const uint32_t y0 = (h - side) / 2;

	for (uint32_t oy = 0; oy < APP_RGB_SIDE; oy++) {
		uint32_t ya = y0 + (oy * side) / APP_RGB_SIDE;
		uint32_t yb = y0 + ((oy + 1) * side) / APP_RGB_SIDE;

		for (uint32_t ox = 0; ox < APP_RGB_SIDE; ox++) {
			uint32_t xa = x0 + (ox * side) / APP_RGB_SIDE;
			uint32_t xb = x0 + ((ox + 1) * side) / APP_RGB_SIDE;
			uint32_t r = 0, g = 0, b = 0, n = 0;

			for (uint32_t y = ya; y < yb; y++) {
				const uint8_t *row = frame + y * fmt.pitch;

				for (uint32_t x = xa; x < xb; x++) {
					uint16_t v = rgb565_at(row + 2 * x);

					r += (v >> 11) & 0x1f;
					g += (v >> 5) & 0x3f;
					b += v & 0x1f;
					n++;
				}
			}
			if (n == 0) {
				n = 1;
			}
			out[out_index(ox, oy, APP_RGB_SIDE)] =
				(uint16_t)(((r / n) << 11) | ((g / n) << 5) | (b / n));
		}
	}
}
#endif /* CONFIG_APP_LEGO */

/* The newest frame, already reduced to 28x28. A thread keeps it fresh so the
 * driver always gets its buffers back at once: with two buffers it drops a
 * frame, and then stops delivering, whenever a buffer is held for longer than
 * a frame period, and one inference takes several.
 */
static uint8_t latest[APP_IMG_SIDE * APP_IMG_SIDE];
static K_MUTEX_DEFINE(latest_lock);
static K_SEM_DEFINE(latest_ready, 0, 1);

static int grab(void)
{
	struct video_buffer *vbuf = NULL;
	struct video_buffer tmp = {.type = VIDEO_BUF_TYPE_OUTPUT};
	int ret;

	vbuf = &tmp;
	ret = video_dequeue(cam, &vbuf, K_FOREVER);
	if (ret < 0) {
		LOG_ERR("video_dequeue: %d", ret);
		return ret;
	}

	const uint32_t w = fmt.width;
	const uint32_t h = fmt.height;
	const uint32_t side = (w < h) ? w : h;
	const uint32_t x0 = (w - side) / 2;
	const uint32_t y0 = (h - side) / 2;
	const uint8_t *frame = vbuf->buffer;

#ifdef CONFIG_APP_LEGO
	/* Reduced straight into the shared picture: a second copy would cost
	 * 18 KiB, and the reader only waits a few milliseconds. */
	k_mutex_lock(&latest_lock, K_FOREVER);
	reduce_rgb(frame, latest_rgb);
	k_mutex_unlock(&latest_lock);
	ret = video_enqueue(cam, vbuf);
	if (ret < 0) {
		LOG_ERR("video_enqueue: %d", ret);
		return ret;
	}
	k_sem_give(&latest_ready);
	ARG_UNUSED(x0);
	ARG_UNUSED(y0);

	return 0;
#else
	static uint8_t gray[APP_IMG_SIDE * APP_IMG_SIDE];

	for (uint32_t oy = 0; oy < APP_IMG_SIDE; oy++) {
		uint32_t ya = y0 + (oy * side) / APP_IMG_SIDE;
		uint32_t yb = y0 + ((oy + 1) * side) / APP_IMG_SIDE;

		for (uint32_t ox = 0; ox < APP_IMG_SIDE; ox++) {
			uint32_t xa = x0 + (ox * side) / APP_IMG_SIDE;
			uint32_t xb = x0 + ((ox + 1) * side) / APP_IMG_SIDE;
			uint32_t sum = 0, n = 0;

			for (uint32_t y = ya; y < yb; y++) {
				const uint8_t *row = frame + y * fmt.pitch;

				for (uint32_t x = xa; x < xb; x++) {
					sum += rgb565_to_gray(row + 2 * x);
					n++;
				}
			}
			uint32_t v = n ? sum / n : 0;

			gray[out_index(ox, oy, APP_IMG_SIDE)] = (uint8_t)v;
		}
	}

	ret = video_enqueue(cam, vbuf);
	if (ret < 0) {
		LOG_ERR("video_enqueue: %d", ret);
		return ret;
	}

	k_mutex_lock(&latest_lock, K_FOREVER);
	memcpy(latest, gray, sizeof(latest));
	k_mutex_unlock(&latest_lock);
	k_sem_give(&latest_ready);

	return 0;
#endif /* CONFIG_APP_LEGO */
}

static void grab_thread(void *a, void *b, void *c)
{
	ARG_UNUSED(a);
	ARG_UNUSED(b);
	ARG_UNUSED(c);

	while (grab() == 0) {
	}
}

K_THREAD_STACK_DEFINE(grab_stack, 2048);

#ifdef CONFIG_APP_LEGO
int app_camera_capture_rgb565(uint16_t *out)
{
	if (k_sem_take(&latest_ready, K_MSEC(2000)) != 0) {
		LOG_ERR("no frame from the camera");
		return -EIO;
	}
	k_mutex_lock(&latest_lock, K_FOREVER);
	memcpy(out, latest_rgb, sizeof(latest_rgb));
	k_mutex_unlock(&latest_lock);
	return 0;
}
#endif

int app_camera_capture(float *out, uint8_t *preview, float mean, float std)
{
	static uint8_t gray[APP_IMG_SIDE * APP_IMG_SIDE];
	uint32_t lo = 255, hi = 0;

	if (k_sem_take(&latest_ready, K_MSEC(2000)) != 0) {
		LOG_ERR("no frame from the camera");
		return -EIO;
	}
	k_mutex_lock(&latest_lock, K_FOREVER);
	memcpy(gray, latest, sizeof(gray));
	k_mutex_unlock(&latest_lock);

	for (uint32_t i = 0; i < APP_IMG_SIDE * APP_IMG_SIDE; i++) {
		lo = MIN(lo, (uint32_t)gray[i]);
		hi = MAX(hi, (uint32_t)gray[i]);
	}

	/* Stretch the contrast so that paper is 0 and the darkest ink 255 after
	 * inversion (MNIST is light strokes on dark), and push light paper noise
	 * to the background. A page with nothing on it stays dark.
	 */
	const uint32_t range = hi > lo + 16 ? hi - lo : 16;

	for (uint32_t i = 0; i < APP_IMG_SIDE * APP_IMG_SIDE; i++) {
		int32_t v = 255 - (int32_t)((gray[i] - lo) * 255u / range);

		if (v < 64) {
			v = 0;
		}
		if (preview) {
			preview[i] = (uint8_t)v;
		}
		out[i] = ((float)v / 255.0f - mean) / std;
	}

	return 0;
}
```

## src/camera.h
```c
/* Copyright (c) 2026 Eoin Jordan
 * SPDX-License-Identifier: Apache-2.0
 */
#pragma once

#include <stdint.h>

#ifdef __cplusplus
extern "C" {
#endif

#define APP_IMG_SIDE 28

/* Bring up the camera chosen in devicetree (zephyr,camera) at 160x120 RGB565
 * and start streaming. Returns 0 or a negative errno.
 */
int app_camera_init(void);

/* Block for the next frame, centre-crop to a square, box-downsample to
 * 28x28 grayscale, stretch the contrast, invert (MNIST is light-on-dark) and
 * normalise with (x/255 - mean) / std into `out` (row-major, 784 floats).
 * `preview`, if not NULL, receives the 28x28 8-bit image the model is given,
 * before normalisation.
 */
int app_camera_capture(float *out, uint8_t *preview, float mean, float std);

/* Side of the colour picture for the brick detector (CONFIG_APP_LEGO). */
#define APP_RGB_SIDE 96

/* Block for the next frame, centre-crop to a square and box-reduce it to
 * 96 x 96 RGB565 in host byte order (`out`, row-major, 9216 pixels).
 * Only with CONFIG_APP_LEGO, which makes the capture thread keep the colour
 * picture and not the 28x28 grayscale one.
 */
int app_camera_capture_rgb565(uint16_t *out);

#ifdef __cplusplus
}
#endif
```

## src/screen.c
```c
/* Copyright (c) 2026 Eoin Jordan
 * SPDX-License-Identifier: Apache-2.0
 */
#include "screen.h"

#include <errno.h>
#include <string.h>

#include <zephyr/device.h>
#include <zephyr/drivers/display.h>
#include <zephyr/kernel.h>
#include <zephyr/sys/printk.h>

#include "font6x8.h"

#define BAND_ROWS CONFIG_APP_SCREEN_BAND_ROWS

static const struct device *const disp = DEVICE_DT_GET(DT_CHOSEN(zephyr_display));
static uint16_t band[SCREEN_W * BAND_ROWS];
static int band_y0;
static bool ready;
static bool dump_next;

/* RGB565 as the panel reads it. The GC9A01 takes the high byte first and
 * the driver sends the buffer unchanged, so on a little-endian CPU the two
 * bytes are swapped here. */
static inline uint16_t pack(uint16_t c)
{
	return IS_ENABLED(CONFIG_APP_SCREEN_SWAP_BYTES) ? (uint16_t)((c << 8) | (c >> 8)) : c;
}

/* The band as text: one line a row, four hex digits a pixel. */
static void dump_band(int rows)
{
	static const char hex[] = "0123456789abcdef";
	static char line[SCREEN_W * 4 + 1];

	for (int y = 0; y < rows; y++) {
		for (int x = 0; x < SCREEN_W; x++) {
			uint16_t c = pack(band[y * SCREEN_W + x]); /* pack() undoes itself */

			line[4 * x] = hex[c >> 12];
			line[4 * x + 1] = hex[(c >> 8) & 0xf];
			line[4 * x + 2] = hex[(c >> 4) & 0xf];
			line[4 * x + 3] = hex[c & 0xf];
		}
		line[SCREEN_W * 4] = '\0';
		printk("%s\n", line);
	}
}

static inline void put(int x, int y, uint16_t packed)
{
	y -= band_y0;
	if (x >= 0 && x < SCREEN_W && y >= 0 && y < BAND_ROWS) {
		band[y * SCREEN_W + x] = packed;
	}
}

int screen_init(void)
{
	struct display_capabilities caps;
	int ret;

	if (!device_is_ready(disp)) {
		printk("screen: display not ready\n");
		return -ENODEV;
	}
	display_get_capabilities(disp, &caps);
	printk("screen: %s %ux%u, pixel format 0x%x\n", disp->name, caps.x_resolution,
	       caps.y_resolution, (unsigned int)caps.current_pixel_format);
	if (caps.x_resolution != SCREEN_W || caps.y_resolution != SCREEN_H) {
		printk("screen: written for %dx%d\n", SCREEN_W, SCREEN_H);
		return -ENOTSUP;
	}
	if (caps.current_pixel_format != PIXEL_FORMAT_RGB_565) {
		ret = display_set_pixel_format(disp, PIXEL_FORMAT_RGB_565);
		if (ret != 0) {
			printk("screen: no 16-bit colour mode (%d)\n", ret);
			return ret;
		}
	}
	ready = true;
	screen_render(NULL, NULL);
	return display_blanking_off(disp);
}

void screen_render(screen_draw_fn draw, void *ctx)
{
	struct display_buffer_descriptor desc = {
		.width = SCREEN_W,
		.pitch = SCREEN_W,
	};

	if (!ready) {
		return;
	}
	if (dump_next) {
		printk("SCR %d %d rgb565\n", SCREEN_W, SCREEN_H);
	}
	for (band_y0 = 0; band_y0 < SCREEN_H; band_y0 += BAND_ROWS) {
		int rows = MIN(BAND_ROWS, SCREEN_H - band_y0);
		int ret;

		memset(band, 0, sizeof(band));
		if (draw != NULL) {
			draw(ctx);
		}
		if (dump_next) {
			dump_band(rows);
		}
		desc.height = rows;
		desc.buf_size = (uint32_t)rows * SCREEN_W * sizeof(uint16_t);
		ret = display_write(disp, 0, band_y0, &desc, band);
		if (ret != 0) {
			printk("screen: display_write %d\n", ret);
			break;
		}
	}
	if (dump_next) {
		printk("END SCR\n");
		dump_next = false;
	}
}

void screen_dump_next(void)
{
	dump_next = true;
}

void screen_fill(int x, int y, int w, int h, uint16_t color)
{
	uint16_t c = pack(color);

	for (int iy = MAX(y, band_y0); iy < MIN(y + h, band_y0 + BAND_ROWS); iy++) {
		for (int ix = x; ix < x + w; ix++) {
			put(ix, iy, c);
		}
	}
}

void screen_text(int x, int y, const char *s, int scale, uint16_t color)
{
	uint16_t c = pack(color);

	if (y + SCREEN_FONT_H * scale <= band_y0 || y >= band_y0 + BAND_ROWS) {
		return;
	}
	for (; *s != '\0'; s++, x += SCREEN_FONT_W * scale) {
		unsigned int ch = (unsigned char)*s;

		if (ch < FONT_FIRST || ch > FONT_LAST) {
			ch = '?';
		}
		const uint8_t *glyph = kFont6x8[ch - FONT_FIRST];

		for (int cx = 0; cx < FONT_W; cx++) {
			for (int cy = 0; cy < FONT_H; cy++) {
				if (((glyph[cx] >> cy) & 1) == 0) {
					continue;
				}
				for (int sy = 0; sy < scale; sy++) {
					for (int sx = 0; sx < scale; sx++) {
						put(x + cx * scale + sx, y + cy * scale + sy, c);
					}
				}
			}
		}
	}
}

void screen_rgb565(int x, int y, const uint16_t *img, int w, int h, int scale)
{
	if (y + h * scale <= band_y0 || y >= band_y0 + BAND_ROWS) {
		return;
	}
	for (int iy = 0; iy < h; iy++) {
		int py = y + iy * scale;

		if (py + scale <= band_y0 || py >= band_y0 + BAND_ROWS) {
			continue;
		}
		for (int ix = 0; ix < w; ix++) {
			uint16_t c = pack(img[iy * w + ix]);

			for (int sy = 0; sy < scale; sy++) {
				for (int sx = 0; sx < scale; sx++) {
					put(x + ix * scale + sx, py + sy, c);
				}
			}
		}
	}
}

void screen_frame(int x, int y, int w, int h, int t, uint16_t color)
{
	screen_fill(x, y, w, t, color);
	screen_fill(x, y + h - t, w, t, color);
	screen_fill(x, y, t, h, color);
	screen_fill(x + w - t, y, t, h, color);
}

void screen_gray(int x, int y, const uint8_t *img, int w, int h, int scale)
{
	if (y + h * scale <= band_y0 || y >= band_y0 + BAND_ROWS) {
		return;
	}
	for (int iy = 0; iy < h; iy++) {
		for (int ix = 0; ix < w; ix++) {
			uint8_t v = img[iy * w + ix];
			uint16_t c = pack(RGB565(v, v, v));

			for (int sy = 0; sy < scale; sy++) {
				for (int sx = 0; sx < scale; sx++) {
					put(x + ix * scale + sx, y + iy * scale + sy, c);
				}
			}
		}
	}
}
```

## src/test_input_q.h
```c
/* Generated by train/export_cmsis_nn.py. Do not edit.
 * MNIST test index 0, label 7: the image in test_input.h.
 * Logits of the int8 model, computed in PyTorch from the quantised graph.
 * The integer kernels on the device may differ from them by a rounding
 * step of the output scale, never by more than a few.
 */
#pragma once

/* One step of the int8 output: logits are multiples of this. */
#define TEST_LOGIT_STEP_Q 0.150078f

static const float kTestExpectedLogitsQ[10] = {
    -1.200621f, -2.251164f, 4.052096f, 2.551320f, -5.702950f, -5.853027f, -8.104192f, 10.505434f, -2.251164f, -0.150078f,
};
```
