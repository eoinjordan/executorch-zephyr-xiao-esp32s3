/* Copyright (c) 2026 Eoin Jordan
 * SPDX-License-Identifier: Apache-2.0
 *
 * Bricks by colour for a pick-and-place arm (CONFIG_APP_LEGO).
 *
 * BrickNet (train/lego_model.py) turns a 96 x 96 colour picture into a
 * 12 x 12 grid of classes: background, yellow, white, red and the blue
 * parts bin. Touching cells of one class are one object, and its
 * centroid goes out on the console, one line a frame:
 *
 *   DET n=2 yellow 0.42 0.61 0.93 red 0.70 0.33 0.88 bin 0.15 0.20 0.97 ms=41
 *
 * n bricks, each as colour, x, y and confidence, then the bin if it is in
 * view, then the time of the inference. x runs from 0 at the left to 1 at
 * the right of the picture, y from 0 at the top to 1 at the bottom.
 *
 * 1. Load the programs embedded in flash: fp32 on the portable kernels and,
 *    unless built with -DAPP_CMSIS_NN=OFF, int8 on the CMSIS-NN kernels.
 * 2. Run each on a synthetic picture baked into lego_test_input.h and
 *    compare the logits with PyTorch.
 * 3. With CONFIG_APP_CAMERA, detect in every camera frame, and with
 *    CONFIG_APP_SCREEN show the frame with a marker on each object.
 *
 * A host can ask for pictures by sending one character on the console:
 *   c   the next frame as the model gets it, before its DET line
 *   s   the next screen as it is drawn
 *   i   the start-up report again: sizes, self-tests and timings
 *   t   one frame from the embedded synthetic picture, not the camera
 * tools/lego_capture.py sends them.
 */

#include <executorch/extension/data_loader/buffer_data_loader.h>
#include <executorch/runtime/core/memory_allocator.h>
#include <executorch/runtime/core/span.h>
#include <executorch/runtime/executor/memory_manager.h>
#include <executorch/runtime/executor/method.h>
#include <executorch/runtime/executor/program.h>
#include <executorch/runtime/platform/log.h>
#include <executorch/runtime/platform/runtime.h>

#include <zephyr/device.h>
#include <zephyr/drivers/uart.h>
#include <zephyr/kernel.h>
#include <zephyr/sys/printk.h>
#include <zephyr/version.h>

#ifdef CONFIG_ESP_SPIRAM
#include <zephyr/multi_heap/shared_multi_heap.h>
#endif

#include <cmath>
#include <cstdint>
#include <cstring>
#include <vector>

#include "lego_test_input.h" /* generated by train/export_lego.py */
#include "model_pte.h"       /* generated: model_pte[], model_pte_len */

#ifdef APP_CMSIS_NN
#include "model_q_pte.h" /* generated: model_q_pte[], model_q_pte_len */
#endif

#ifdef CONFIG_APP_CAMERA
#include "camera.h"
#endif
#ifdef CONFIG_APP_SCREEN
#include "screen.h"
#endif

using executorch::aten::ScalarType;
using executorch::aten::Tensor;
using executorch::aten::TensorImpl;
using executorch::extension::BufferDataLoader;
using executorch::runtime::Error;
using executorch::runtime::EValue;
using executorch::runtime::HierarchicalAllocator;
using executorch::runtime::MemoryAllocator;
using executorch::runtime::MemoryManager;
using executorch::runtime::Method;
using executorch::runtime::MethodMeta;
using executorch::runtime::Program;
using executorch::runtime::Result;
using executorch::runtime::Span;
using executorch::runtime::TensorInfo;

/* Same constants as train/lego_model.py */
static constexpr int kSide = 96;
static constexpr int kGrid = 12;
static constexpr int kClasses = 5;
static constexpr int kBin = 4;
static constexpr int kCells = kGrid * kGrid;
static constexpr int kLogits = kClasses * kCells;
static constexpr float kThreshold = 0.6f;
static constexpr int kMaxBricks = 8;

static const char *const kNames[kClasses] = {"background", "yellow", "white", "red", "bin"};

#ifdef APP_CMSIS_NN
/* The int8 program works in internal RAM. */
alignas(16) static uint8_t q_method_pool[CONFIG_APP_LEGO_METHOD_POOL_SIZE];
alignas(16) static uint8_t q_temp_pool[CONFIG_APP_LEGO_TEMP_POOL_SIZE];
#endif
alignas(16) static uint8_t temp_pool[CONFIG_APP_LEGO_TEMP_POOL_SIZE];

namespace {

struct Detection {
	int cls;
	float x;
	float y;
	float conf;
	int cells;
};

struct Found {
	Detection bricks[kMaxBricks];
	int n;
	bool has_bin;
	Detection bin;
	uint32_t us;
};

/* Memory for things too large for the internal RAM: the PSRAM of the
 * module when it is enabled, the heap otherwise. The fp32 program needs
 * about 300 KB for a 96 x 96 x 3 float picture and its first feature map. */
uint8_t *big_alloc(size_t size)
{
#ifdef CONFIG_ESP_SPIRAM
	return static_cast<uint8_t *>(shared_multi_heap_aligned_alloc(SMH_REG_ATTR_EXTERNAL, 16, size));
#else
	return static_cast<uint8_t *>(k_aligned_alloc(16, size));
#endif
}

/* One loaded program with its memory, ready to run. */
class Runner {
      public:
	Runner(const char *name, const uint8_t *pte, size_t pte_len, uint8_t *method_mem,
	       size_t method_size, uint8_t *temp_mem, size_t temp_size)
		: name(name), pte_len(pte_len), loader_(pte, pte_len),
		  method_allocator_(method_size, method_mem), temp_allocator_(temp_size, temp_mem)
	{
	}

	Error init();
	void info() const;
	/* A 96 x 96 picture in, as RGB bytes or, when rgb888 is null, as RGB565
	 * in host order. Logits [class][row][column] and the time of execute()
	 * out. */
	Error run(const uint8_t *rgb888, const uint16_t *rgb565, float *logits, uint32_t *us);

	const char *const name;
	const size_t pte_len;

      private:
	BufferDataLoader loader_;
	MemoryAllocator method_allocator_;
	MemoryAllocator temp_allocator_;
	std::vector<Span<uint8_t>> planned_spans_;
	Program *program_ = nullptr;
	Method *method_ = nullptr;
	Tensor *input_tensor_ = nullptr;
	void *input_ = nullptr;
	size_t planned_ = 0;
	bool input_int8_ = false;
	bool input_nhwc_ = false;
	int8_t lut_[256];
};

/* True when a four-dimensional tensor keeps its data as rows of pixels with
 * the channels together (NHWC) and not as one plane per channel (NCHW). */
template <typename T> bool channels_last(const T &dim_order)
{
	return dim_order.size() == 4 && dim_order[1] == 2 && dim_order[2] == 3 && dim_order[3] == 1;
}

Error Runner::init()
{
	Result<Program> program_res = Program::load(&loader_);
	if (!program_res.ok()) {
		ET_LOG(Error, "%s: Program::load failed: 0x%x", name, (unsigned)program_res.error());
		return program_res.error();
	}
	program_ = new Program(std::move(program_res.get()));

	const char *method_name = program_->get_method_name(0).get();
	Result<MethodMeta> meta = program_->method_meta(method_name);
	if (!meta.ok()) {
		return meta.error();
	}

	size_t planned = 0;
	for (size_t id = 0; id < meta->num_memory_planned_buffers(); ++id) {
		size_t size = static_cast<size_t>(meta->memory_planned_buffer_size(id).get());
		uint8_t *buf = static_cast<uint8_t *>(method_allocator_.allocate(size, 16));
		if (buf == nullptr) {
			ET_LOG(Error, "%s: planned buffer %zu (%zu B) does not fit the method pool",
			       name, id, size);
			return Error::MemoryAllocationFailed;
		}
		planned += size;
		planned_spans_.push_back({buf, size});
	}

	auto *planned_memory =
		new HierarchicalAllocator({planned_spans_.data(), planned_spans_.size()});
	auto *memory_manager =
		new MemoryManager(&method_allocator_, planned_memory, &temp_allocator_);

	Result<Method> method_res = program_->load_method(method_name, memory_manager);
	if (!method_res.ok()) {
		ET_LOG(Error, "%s: load_method(%s) failed: 0x%x", name, method_name,
		       (unsigned)method_res.error());
		return method_res.error();
	}
	method_ = new Method(std::move(method_res.get()));

	/* The fp32 program takes floats, one plane per channel. The int8 one
	 * takes the picture as int8 with the channels together: its quantize
	 * operator was removed at export, so the bytes go in through a table. */
	Result<TensorInfo> in_meta = meta->input_tensor_meta(0);
	if (!in_meta.ok()) {
		return in_meta.error();
	}
	input_int8_ = in_meta->scalar_type() == ScalarType::Char;
	input_nhwc_ = channels_last(in_meta->dim_order());
	const size_t want = kSide * kSide * 3 * (input_int8_ ? 1 : sizeof(float));
	if (in_meta->nbytes() != want ||
	    (!input_int8_ && in_meta->scalar_type() != ScalarType::Float)) {
		ET_LOG(Error, "%s: the input is not a 96 x 96 x 3 picture", name);
		return Error::InvalidProgram;
	}
	/* The picture is written here and copied into the program by
	 * set_input(), so this buffer need not be in fast memory. */
	input_ = big_alloc(in_meta->nbytes());
	if (input_ == nullptr) {
		return Error::MemoryAllocationFailed;
	}
	for (int v = 0; v < 256; ++v) {
		float q = roundf(static_cast<float>(v) / 255.f / LEGO_Q_INPUT_SCALE) +
			  LEGO_Q_INPUT_ZERO_POINT;
		lut_[v] = static_cast<int8_t>(fminf(fmaxf(q, -128.f), 127.f));
	}
	auto *impl = new TensorImpl(
		in_meta->scalar_type(), in_meta->sizes().size(),
		const_cast<TensorImpl::SizesType *>(in_meta->sizes().data()), input_,
		const_cast<TensorImpl::DimOrderType *>(in_meta->dim_order().data()));
	input_tensor_ = new Tensor(impl);

	planned_ = planned;
	return Error::Ok;
}

void Runner::info() const
{
	printk("%-9s %6u bytes in flash, %6u planned, pool %6u of %6u bytes used, %s %s input\n",
	       name, (unsigned)pte_len, (unsigned)planned_, (unsigned)method_allocator_.used_size(),
	       (unsigned)method_allocator_.size(), input_int8_ ? "int8" : "float",
	       input_nhwc_ ? "NHWC" : "NCHW");
}

Error Runner::run(const uint8_t *rgb888, const uint16_t *rgb565, float *logits, uint32_t *us)
{
	const int plane = kSide * kSide;
	int8_t *in_q = static_cast<int8_t *>(input_);
	float *in_f = static_cast<float *>(input_);

	for (int i = 0; i < plane; ++i) {
		uint8_t px[3];

		if (rgb888 != nullptr) {
			px[0] = rgb888[3 * i];
			px[1] = rgb888[3 * i + 1];
			px[2] = rgb888[3 * i + 2];
		} else {
			/* Fill the low bits as the training pictures do. */
			const uint16_t v = rgb565[i];
			const uint8_t r = (v >> 11) & 0x1f, g = (v >> 5) & 0x3f, b = v & 0x1f;

			px[0] = static_cast<uint8_t>((r << 3) | (r >> 2));
			px[1] = static_cast<uint8_t>((g << 2) | (g >> 4));
			px[2] = static_cast<uint8_t>((b << 3) | (b >> 2));
		}
		for (int c = 0; c < 3; ++c) {
			const int at = input_nhwc_ ? i * 3 + c : c * plane + i;

			if (input_int8_) {
				in_q[at] = lut_[px[c]];
			} else {
				in_f[at] = static_cast<float>(px[c]) * (1.f / 255.f);
			}
		}
	}
	Error err = method_->set_input(EValue(*input_tensor_), 0);
	if (err != Error::Ok) {
		ET_LOG(Error, "%s: set_input failed: 0x%x", name, (unsigned)err);
		return err;
	}

	uint32_t t0 = k_cycle_get_32();
	err = method_->execute();
	uint32_t t1 = k_cycle_get_32();
	if (err != Error::Ok) {
		ET_LOG(Error, "%s: execute failed: 0x%x", name, (unsigned)err);
		return err;
	}
	*us = k_cyc_to_us_floor32(t1 - t0);

	const EValue &out = method_->get_output(0);
	if (!out.isTensor()) {
		return Error::InvalidState;
	}
	const Tensor &t = out.toTensor();
	if (t.numel() != kLogits || t.scalar_type() != ScalarType::Float) {
		return Error::InvalidState;
	}
	const float *data = t.const_data_ptr<float>();
	if (channels_last(t.dim_order())) {
		for (int cell = 0; cell < kCells; ++cell) {
			for (int c = 0; c < kClasses; ++c) {
				logits[c * kCells + cell] = data[cell * kClasses + c];
			}
		}
	} else {
		std::memcpy(logits, data, kLogits * sizeof(float));
	}
	return Error::Ok;
}

/* Logits to objects: the class of each cell, then a flood fill. The same as
 * decode() in train/lego_model.py. */
void decode(const float *logits, Found *res)
{
	static uint8_t cls[kCells];
	static float conf[kCells];
	static bool seen[kCells];
	static int16_t stack[kCells];
	Detection best_bin = {};

	for (int cell = 0; cell < kCells; ++cell) {
		float top = logits[cell];
		int arg = 0;

		for (int c = 1; c < kClasses; ++c) {
			if (logits[c * kCells + cell] > top) {
				top = logits[c * kCells + cell];
				arg = c;
			}
		}
		float sum = 0.f;
		for (int c = 0; c < kClasses; ++c) {
			sum += expf(logits[c * kCells + cell] - top);
		}
		conf[cell] = 1.f / sum;
		cls[cell] = conf[cell] >= kThreshold ? static_cast<uint8_t>(arg) : 0;
		seen[cell] = false;
	}

	res->n = 0;
	res->has_bin = false;
	for (int start = 0; start < kCells; ++start) {
		const int c = cls[start];

		if (c == 0 || seen[start]) {
			continue;
		}
		int top = 0;
		float sw = 0.f, sx = 0.f, sy = 0.f, best = 0.f;
		int n = 0;

		stack[top++] = static_cast<int16_t>(start);
		seen[start] = true;
		while (top > 0) {
			const int cell = stack[--top];
			const int gx = cell % kGrid, gy = cell / kGrid;
			const float w = conf[cell];

			sw += w;
			sx += w * (gx + 0.5f);
			sy += w * (gy + 0.5f);
			best = fmaxf(best, w);
			n++;
			/* Eight neighbours: a brick lying across the grid touches
			 * its next cell by a corner as often as by a side. */
			for (int ny = gy > 0 ? gy - 1 : 0; ny <= gy + 1 && ny < kGrid; ++ny) {
				for (int nx = gx > 0 ? gx - 1 : 0; nx <= gx + 1 && nx < kGrid; ++nx) {
					const int next = ny * kGrid + nx;

					if (!seen[next] && cls[next] == c) {
						seen[next] = true;
						stack[top++] = static_cast<int16_t>(next);
					}
				}
			}
		}
		const Detection d = {c, sx / sw / kGrid, sy / sw / kGrid, best, n};

		if (c == kBin) {
			/* One bin: the largest patch of blue. */
			if (!res->has_bin || d.cells > best_bin.cells ||
			    (d.cells == best_bin.cells && d.conf > best_bin.conf)) {
				best_bin = d;
				res->has_bin = true;
			}
			continue;
		}
		/* Keep the most confident bricks, in order. */
		int at = res->n;

		while (at > 0 && res->bricks[at - 1].conf < d.conf) {
			at--;
		}
		if (at >= kMaxBricks) {
			continue;
		}
		const int last = res->n < kMaxBricks ? res->n : kMaxBricks - 1;

		for (int i = last; i > at; --i) {
			res->bricks[i] = res->bricks[i - 1];
		}
		res->bricks[at] = d;
		if (res->n < kMaxBricks) {
			res->n++;
		}
	}
	res->bin = best_bin;
}

/* Two decimals without the float formatter rounding 0.995 up to "1.00". */
int hundredths(float v)
{
	int h = static_cast<int>(v * 100.f + 0.5f);

	return h < 0 ? 0 : (h > 100 ? 100 : h);
}

void print_det(const Found &res)
{
	printk("DET n=%d", res.n);
	for (int i = 0; i < res.n; ++i) {
		const Detection &d = res.bricks[i];

		printk(" %s %d.%02d %d.%02d %d.%02d", kNames[d.cls], hundredths(d.x) / 100,
		       hundredths(d.x) % 100, hundredths(d.y) / 100, hundredths(d.y) % 100,
		       hundredths(d.conf) / 100, hundredths(d.conf) % 100);
	}
	if (res.has_bin) {
		const Detection &d = res.bin;

		printk(" bin %d.%02d %d.%02d %d.%02d", hundredths(d.x) / 100, hundredths(d.x) % 100,
		       hundredths(d.y) / 100, hundredths(d.y) % 100, hundredths(d.conf) / 100,
		       hundredths(d.conf) % 100);
	}
	printk(" ms=%u\n", (res.us + 500) / 1000);
}

/* Run the embedded picture, compare with the reference and time it.
 * Returns the average time of an inference in microseconds, 0 on failure. */
uint32_t self_test(Runner &runner, const float *expected, float tolerance, Found *res)
{
	static float logits[kLogits];
	uint32_t us = 0;

	if (runner.run(kLegoTestImage, nullptr, logits, &us) != Error::Ok) {
		printk("%s: FAIL: inference\n", runner.name);
		return 0;
	}
	float max_diff = 0.f;
	for (int i = 0; i < kLogits; ++i) {
		max_diff = fmaxf(max_diff, fabsf(logits[i] - expected[i]));
	}
	res->us = us;
	decode(logits, res);

	printk("\n%s self-test: embedded synthetic picture, %d bricks%s\n", runner.name,
	       LEGO_TEST_BRICKS, LEGO_TEST_BIN ? " and the bin" : "");
	printk("  ");
	print_det(*res);
	printk("  found %d bricks%s, max |esp32 - pytorch| = %.2e (limit %.2e)\n", res->n,
	       res->has_bin ? " and the bin" : "", static_cast<double>(max_diff),
	       static_cast<double>(tolerance));
	const bool pass = res->n == LEGO_TEST_BRICKS && res->has_bin == (LEGO_TEST_BIN != 0) &&
			  max_diff <= tolerance;
	printk("%s SELF-TEST %s\n", runner.name, pass ? "PASS" : "FAIL");

	uint32_t total = 0;
	const int reps = 10;
	for (int i = 0; i < reps; ++i) {
		runner.run(kLegoTestImage, nullptr, logits, &us);
		total += us;
	}
	printk("%s inference: %u us average over %d runs\n", runner.name, total / reps, reps);
	res->us = total / reps;
	return pass ? total / reps : 0;
}

void rgb888_to_rgb565(const uint8_t *in, uint16_t *out, int count)
{
	for (int i = 0; i < count; ++i) {
		out[i] = static_cast<uint16_t>(((in[3 * i] & 0xF8) << 8) | ((in[3 * i + 1] & 0xFC) << 3) |
					       (in[3 * i + 2] >> 3));
	}
}

/* The picture as text: one line a row, four hex digits a pixel. */
void dump_image(const uint16_t *img)
{
	static const char hex[] = "0123456789abcdef";
	static char line[kSide * 4 + 1];

	printk("IMG %d %d rgb565\n", kSide, kSide);
	for (int y = 0; y < kSide; ++y) {
		for (int x = 0; x < kSide; ++x) {
			const uint16_t c = img[y * kSide + x];

			line[4 * x] = hex[c >> 12];
			line[4 * x + 1] = hex[(c >> 8) & 0xf];
			line[4 * x + 2] = hex[(c >> 4) & 0xf];
			line[4 * x + 3] = hex[c & 0xf];
		}
		line[kSide * 4] = '\0';
		printk("%s\n", line);
	}
	printk("END IMG\n");
}

#ifdef CONFIG_APP_SCREEN
/* What the screen shows. The picture fills the panel; the round edge cuts
 * its corners. */
struct View {
	const uint16_t *image; /* 96 x 96 RGB565 */
	const Found *res;
	const char *caption;
};

constexpr int kImgX = 24;
constexpr int kImgY = 6;
constexpr int kImgScale = 2;

const uint16_t kClassColor[kClasses] = {
	COLOR_BLACK, RGB565(255, 220, 0), COLOR_WHITE, RGB565(255, 50, 40), RGB565(70, 150, 255),
};

void draw_marker(const Detection &d, int half)
{
	const int cx = kImgX + static_cast<int>(d.x * kSide * kImgScale);
	const int cy = kImgY + static_cast<int>(d.y * kSide * kImgScale);
	const char *label = kNames[d.cls];
	const int tw = static_cast<int>(strlen(label)) * SCREEN_FONT_W;
	int tx = cx - tw / 2;
	int ty = cy + half + 3;

	/* A square in the colour of the class with a black edge either side,
	 * so it shows on any brick and any desk. */
	screen_frame(cx - half - 1, cy - half - 1, 2 * half + 2, 2 * half + 2, 4, COLOR_BLACK);
	screen_frame(cx - half, cy - half, 2 * half, 2 * half, 2, kClassColor[d.cls]);
	screen_fill(cx - 1, cy - 1, 3, 3, kClassColor[d.cls]);

	if (ty + SCREEN_FONT_H + 2 > kImgY + kSide * kImgScale) {
		ty = cy - half - SCREEN_FONT_H - 4;
	}
	tx = tx < kImgX ? kImgX : tx;
	if (tx + tw > kImgX + kSide * kImgScale) {
		tx = kImgX + kSide * kImgScale - tw;
	}
	screen_fill(tx - 1, ty - 1, tw + 2, SCREEN_FONT_H + 2, COLOR_BLACK);
	screen_text(tx, ty, label, 1, kClassColor[d.cls]);
}

void draw_view(void *ctx)
{
	const View *v = static_cast<const View *>(ctx);
	const Found &res = *v->res;
	char text[24];

	screen_rgb565(kImgX, kImgY, v->image, kSide, kSide, kImgScale);
	if (res.has_bin) {
		draw_marker(res.bin, 14);
	}
	for (int i = 0; i < res.n; ++i) {
		draw_marker(res.bricks[i], 8);
	}

	snprintk(text, sizeof(text), "n=%d %ums", res.n, (res.us + 500) / 1000);
	screen_text(120 - SCREEN_FONT_W * static_cast<int>(strlen(text)), 202, text, 2, COLOR_WHITE);
	screen_text(120 - SCREEN_FONT_W / 2 * static_cast<int>(strlen(v->caption)), 222, v->caption,
		    1, res.has_bin ? kClassColor[kBin] : COLOR_GREY);
}
#endif /* CONFIG_APP_SCREEN */

/* The start-up report: sizes, the self-test of each program and its time.
 * Returns the program for the camera loop. A host that opened the port too
 * late to see it can ask for it again with 'i'. */
Runner *report(Runner &fp32, Runner *int8, Found *res)
{
	Runner *live = &fp32;

	printk("\nExecuTorch BrickNet on %s (Zephyr %s)\n", CONFIG_BOARD_TARGET,
	       KERNEL_VERSION_STRING);
	fp32.info();
	if (int8 != nullptr) {
		int8->info();
	}

	const uint32_t us = self_test(fp32, kLegoTestLogits, 1e-3f, res);

	if (int8 != nullptr) {
		/* The integer kernels round a little differently from the
		 * quantised graph in PyTorch, and the layers add up. */
		const uint32_t us_q = self_test(*int8, kLegoTestLogitsQ,
						CONFIG_APP_LEGO_INT8_STEPS * LEGO_Q_LOGIT_STEP, res);

		if (us != 0 && us_q != 0) {
			printk("\nint8 on CMSIS-NN is %u.%02ux the speed of fp32 on the portable "
			       "kernels\n",
			       us / us_q, (us % us_q) * 100 / us_q);
		}
		if (!IS_ENABLED(CONFIG_APP_LEGO_LIVE_FP32)) {
			live = int8;
		}
	}
	printk("live program: %s\n", live->name);
	return live;
}

} // namespace

int main(void)
{
	executorch::runtime::runtime_init();

	static Found res;
	Runner *int8_or_null = nullptr;

	uint8_t *pool = big_alloc(CONFIG_APP_LEGO_FP32_POOL_SIZE);
	if (pool == nullptr) {
		printk("FAIL: no %d bytes for the fp32 program (is the PSRAM enabled?)\n",
		       CONFIG_APP_LEGO_FP32_POOL_SIZE);
		return 1;
	}
	static Runner fp32("portable", model_pte, model_pte_len, pool, CONFIG_APP_LEGO_FP32_POOL_SIZE,
			   temp_pool, sizeof(temp_pool));
	if (fp32.init() != Error::Ok) {
		printk("FAIL: runtime init (portable)\n");
		return 1;
	}
#ifdef APP_CMSIS_NN
	static Runner int8("cmsis-nn", model_q_pte, model_q_pte_len, q_method_pool,
			   sizeof(q_method_pool), q_temp_pool, sizeof(q_temp_pool));
	if (int8.init() != Error::Ok) {
		printk("FAIL: runtime init (cmsis-nn)\n");
		return 1;
	}
	int8_or_null = &int8;
#endif

	/* --- 1. Self-test on the embedded synthetic picture ------------------ */
	Runner *const live = report(fp32, int8_or_null, &res);

	static uint16_t frame[kSide * kSide];

#ifdef CONFIG_APP_SCREEN
	static View view;

	rgb888_to_rgb565(kLegoTestImage, frame, kSide * kSide);
	view.image = frame;
	view.res = &res;
	view.caption = "self-test";
	const bool have_screen = screen_init() == 0;
	if (have_screen) {
		screen_render(draw_view, &view);
	}
#endif

	/* --- 2. Live camera loop --------------------------------------------- */
#ifdef CONFIG_APP_CAMERA
	const struct device *const console = DEVICE_DT_GET(DT_CHOSEN(zephyr_console));
	static float logits[kLogits];

	if (app_camera_init() != 0) {
		printk("camera init failed; stopping after self-test\n");
		return 0;
	}
#ifdef CONFIG_APP_SCREEN
	k_msleep(1500); /* leave the self-test picture up for a moment */
	view.caption = live->name;
#endif

	for (;;) {
		bool want_image = false;
		bool want_test = false;
		unsigned char ch;

		while (device_is_ready(console) && uart_poll_in(console, &ch) == 0) {
			if (ch == 'c') {
				want_image = true;
			}
			if (ch == 'i') {
				report(fp32, int8_or_null, &res);
			}
			if (ch == 't') {
				want_test = true;
			}
#ifdef CONFIG_APP_SCREEN
			if (ch == 's') {
				screen_dump_next();
			}
#endif
		}

		Error err;

		if (want_test) {
			/* One frame from the embedded picture instead of the camera. */
			rgb888_to_rgb565(kLegoTestImage, frame, kSide * kSide);
			err = live->run(kLegoTestImage, nullptr, logits, &res.us);
		} else {
			if (app_camera_capture_rgb565(frame) != 0) {
				k_msleep(CONFIG_APP_CAMERA_INTERVAL_MS);
				continue;
			}
			err = live->run(nullptr, frame, logits, &res.us);
		}
		if (err != Error::Ok) {
			k_msleep(CONFIG_APP_CAMERA_INTERVAL_MS);
			continue;
		}
		decode(logits, &res);
#ifdef CONFIG_APP_SCREEN
		view.caption = want_test ? "self-test" : live->name;
#endif

		if (want_image) {
			dump_image(frame);
		}
		print_det(res);
#ifdef CONFIG_APP_SCREEN
		if (have_screen) {
			screen_render(draw_view, &view);
		}
#endif
		k_msleep(CONFIG_APP_CAMERA_INTERVAL_MS);
	}
#endif
	return 0;
}
